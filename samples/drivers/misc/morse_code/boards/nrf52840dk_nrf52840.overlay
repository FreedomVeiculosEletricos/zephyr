/*
 * Copyright (c) 2024 Freedom Veiculos Eletricos
 * Copyright (c) 2024 OS Systems
 *
 * SPDX-License-Identifier: Apache-2.0
 */

/ {
	morse: morse {
		compatible = "zephyr,morse-code";

		speed = <20>;
		pwms = <&sw_pwm 0 PWM_MSEC(20) PWM_POLARITY_INVERTED>;
		timer-unit = <&timer0>;
	};
};

&timer0 {
	status = "okay";
};

&sw_pwm {
	status = "okay";
	channel-gpios = <&gpio0 13 PWM_POLARITY_INVERTED>;
};
