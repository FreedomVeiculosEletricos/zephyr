/*
 * Copyright (c) 2024 Freedom Veiculos Eletricos
 * Copyright (c) 2024 OS Systems
 *
 * SPDX-License-Identifier: Apache-2.0
 */

/ {
	morse: morse {
		compatible = "zephyr,morse-code";

		speed = <20>;
		pwms = <&pwm0 0 PWM_MSEC(20) PWM_POLARITY_INVERTED>;
		timer-unit = <&tc1>;
	};
};

&tc1 {
        clk = <4>;
        status = "okay";
};
