## tests/drivers/console/line_splitting/testcase.yaml
```yaml
common:
  tags:
    - drivers
    - console
  platform_allow: hifive1 hifive_unleashed
  harness: robot

tests:
  drivers.console.line_splitting:
    harness_config:
      robot_testsuite: line_splitting.robot
```
